## boards/shields/caldera/Kconfig.defconfig
```kconfig
# Copyright (c) 2023 The ZMK Contributors
# SPDX-License-Identifier: MIT

if SHIELD_CALDERA_LEFT || SHIELD_CALDERA_RIGHT

config ZMK_KEYBOARD_NAME
    default "Caldera"

config ZMK_SPLIT_BLE_CENTRAL_PERIPHERALS
    default 1

endif

if SHIELD_CALDERA_LEFT

config ZMK_SPLIT_ROLE_CENTRAL
    default y

endif
```
